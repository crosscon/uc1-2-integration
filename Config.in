## Config.in
```kconfig
config BR2_PACKAGE_MTLS
    bool "mtls"
    # Following "depends" can be probably replaced with "select"
    # Must be done right not to break any dependencies
    depends on BR2_PACKAGE_WOLFSSL && BR2_PACKAGE_OPTEE_CLIENT
    help
      TLS client/server example app using wolfSSL.

config BR2_PACKAGE_MTLS_DEBUG
    bool "Enable debug build for mtls"
    depends on BR2_PACKAGE_MTLS
    default n

config BR2_PACKAGE_MTLS_NXP_PUF
    bool "Build for NXP demo (UC1.1)"
    depends on BR2_PACKAGE_MTLS
    default n
    help
      Compiles mtls server with PUF auth support for NXP demo (UC1.1).

config BR2_PACKAGE_MTLS_RPI_CBA
    bool "Build for RPI demo (UC1.2)"
    depends on BR2_PACKAGE_MTLS
    default n
    help
      Compiles mtls server and client with CBA support for RPi demo (UC1.2).
```
